## config/west.yml
```yaml
manifest:
  defaults:
    revision: v0.3
  remotes:
    - name: zmkfirmware
      url-base: https://github.com/zmkfirmware
    # Additional modules containing boards/shields/custom code can be listed here as well
    # See https://docs.zephyrproject.org/3.2.0/develop/west/manifest.html#projects
#    - name: carrefinho                            # <--- add this
#      url-base: https://github.com/carrefinho     # <--- and this
    - name: prospector
      url-base: https://github.com/t-ogura
  projects:
    - name: zmk
      remote: zmkfirmware
      import: app/west.yml
      revision: v0.3
    - name: prospector-zmk-module                 # <--- and these (in og)
      remote: prospector                             #added 
      revision: v2.0.0  # Use specific version tag   #added
      path: modules/prospector-zmk-module            #added
#      remote: carrefinho                          # <---
#      revision: main                              # <---
  self:
    path: config
```
